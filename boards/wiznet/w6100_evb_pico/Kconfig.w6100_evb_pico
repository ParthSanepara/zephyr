## boards/wiznet/w6100_evb_pico/Kconfig.w6100_evb_pico
```kconfig
# Copyright (c) 2021 Yonatan Schachter
# Copyright (c) 2023 Ian Wakely
# SPDX-License-Identifier: Apache-2.0

config BOARD_W6100_EVB_PICO
	select SOC_RP2040
```

## boards/wiznet/w6100_evb_pico/board.yml
```yaml
board:
  name: w6100_evb_pico
  full_name: W6100 Evaluation Pico
  vendor: wiznet
  socs:
  - name: rp2040
```
